## moon/Kconfig
```kconfig
menu "Summer Pocket test kernel features"

config SUMMER_POCKETS
        tristate
	default y
	help
	  It's Summer Pockets!

source "moon/adios/Kconfig"
source "moon/baseguard/Kconfig"
source "moon/symbol_check/Kconfig"
source "moon/tcp/Kconfig"
source "moon/rekernel/Kconfig"
source "moon/sched_ext/Kconfig"
source "moon/ssg/Kconfig"
source "moon/zstdn/Kconfig"

config CRYPTO_LZ4K
        tristate "LZ4K"
        select CRYPTO_ALGAPI
        select CRYPTO_ACOMP2
        select LZ4K_COMPRESS
        select LZ4K_DECOMPRESS
        help
          LZ4K compression algorithm

          See https://github.com/lz4/lz4 for further information.

config CRYPTO_LZ4KD
        tristate "LZ4KD"
        select CRYPTO_ALGAPI
        select CRYPTO_ACOMP2
        select LZ4KD_COMPRESS
        select LZ4KD_DECOMPRESS
        help
          LZ4KD compression algorithm

          See https://github.com/lz4/lz4 for further information.

config LZ4K_COMPRESS
        tristate

config LZ4KD_COMPRESS
        tristate

config LZ4K_DECOMPRESS
        tristate

config LZ4KD_DECOMPRESS
        tristate

endmenu
```

## moon/adios/Kconfig
```kconfig
config MQ_IOSCHED_ADIOS
        tristate "Adaptive Deadline I/O scheduler"
        default y
        help
          The Adaptive Deadline I/O Scheduler (ADIOS) is a multi-queue I/O
          scheduler with learning-based adaptive latency control.
```

## moon/ssg/Kconfig
```kconfig
config MQ_IOSCHED_SSG
	tristate "SamSung Generic I/O scheduler"
	default n
	help
	  SamSung Generic IO scheduler.

config MQ_IOSCHED_SSG_CGROUP
	tristate "Control Group for SamSung Generic I/O scheduler"
	default n
	depends on BLK_CGROUP
	depends on MQ_IOSCHED_SSG
	help
	  Control Group for SamSung Generic IO scheduler.
```

## moon/tcp/Kconfig
```kconfig
config TCP_CONG_BRUTAL
	tristate "Brutal TCP congestion control"
	default n

config TCP_CONG_PIXIE
	tristate "Pixie TCP congestion control"
	default n
    help
      This is the pixie tcp congestion algorithm.
```

## moon/zstdn/Kconfig
```kconfig
config CRYPTO_ZSTDN
	tristate "Zstdn compression algorithm"
	select CRYPTO_ALGAPI
	select CRYPTO_ACOMP2
	help
	  This is the zstdn algorithm.
```
